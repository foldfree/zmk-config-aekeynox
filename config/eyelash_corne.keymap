#include <dt-bindings/zmk/bt.h>
// Redefining Selenium for the Eyelash Corne 48-key matrix
#define SELENIUM_KEYMAP_BINDINGS(LOUT1, LROW1, RROW1, ROUT1, \
                                 LOUT2, LROW2, RROW2, ROUT2, \
                                 LOUT3, LROW3, RROW3, ROUT3, \
                                 LT1, LT2, LT3, RT3, RT2, RT1) \
    LOUT1  LROW1                       &kp UP                        RROW1  ROUT1 \
    LOUT2  LROW2             &kp LEFT  &kp ENTER  &kp RIGHT          RROW2  ROUT2 \
    LOUT3  LROW3  &kp C_MUTE           &kp DOWN                      RROW3  ROUT3 \
                  LT1  LT2  LT3                      RT3  RT2  RT1
#include <aekeynox/selenium.keymap>
/ {
    combos {
        compatible = "zmk,combos";
        mouseless {
            bindings = <&kp F15>;
            key-positions = <44 45>;
        };
    };
};
